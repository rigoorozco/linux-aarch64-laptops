// SPDX-License-Identifier: GPL-2.0
/* Copyright (c) 2019, The Linux Foundation. All rights reserved. */

/dts-v1/;

#include "sdm850-lenovo-yoga-c630.dts"

/ {
	model = "Lenovo Yoga C630";
	compatible = "lenovo,yoga-c630", "qcom,sdm845";
};
